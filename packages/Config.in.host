## packages/Config.in.host
```kconfig
menu "Host utilities 2"

source "$NERVES_DEFCONFIG_DIR/packages/python/Config.in.host"

endmenu
```

## packages/fwup19/Config.in
```kconfig
config BR2_PACKAGE_FWUP19
	bool "fwup19"
	depends on BR2_USE_MMU
	depends on BR2_USE_WCHAR
	select BR2_PACKAGE_LIBARCHIVE
	# required by libarchive to include zip compression
	select BR2_PACKAGE_ZLIB
	select BR2_PACKAGE_LIBCONFUSE
	help
	  Fwup is a scriptable embedded Linux firmware update creator
	  and runner.

	  https://github.com/fhunleth/fwup

comment "fwup19 needs a toolchain w/ wchar"
	depends on BR2_USE_MMU
	depends on !BR2_USE_WCHAR
```

## packages/fwup19/Config.in.host
```kconfig
config BR2_PACKAGE_HOST_FWUP19
	bool "host fwup19"
	help
	  Fwup is a scriptable embedded Linux firmware update creator
	  and runner.

	  https://github.com/fhunleth/fwup
```
